## Documentation/devicetree/bindings/display/panel/clockwork,cpi3-hdmi.yaml
```yaml
# SPDX-License-Identifier: (GPL-2.0-only OR BSD-2-Clause)
%YAML 1.2
---
$id: http://devicetree.org/schemas/display/panel/clockwork,cpi3-hdmi.yaml#
$schema: http://devicetree.org/meta-schemas/core.yaml#

title: Clockwork ClockworkPi CPI3 HDMI output module panel node

description: |
  Placeholder panel node used when the ClockworkPi CPI3 HDMI expansion
  module is fitted.  The module pulls GPIO PL11 low on boot, causing
  U-Boot to select this DTB.  The RGB output of the SoC is routed to
  the HDMI module instead of the built-in LCD.

maintainers:
  - Clockwork Tech LLC <linux@clockworkpi.com>

allOf:
  - $ref: panel-common.yaml#

properties:
  compatible:
    const: clockwork,cpi3-hdmi

  port: true

required:
  - compatible
  - port

unevaluatedProperties: false

examples:
  - |
    panel {
        compatible = "clockwork,cpi3-hdmi";

        port {
            rgb_input: endpoint {
                remote-endpoint = <&tcon0_out_rgb>;
            };
        };
    };
```

## Documentation/devicetree/bindings/display/panel/clockwork,cpi3-lcd.yaml
```yaml
# SPDX-License-Identifier: (GPL-2.0-only OR BSD-2-Clause)
%YAML 1.2
---
$id: http://devicetree.org/schemas/display/panel/clockwork,cpi3-lcd.yaml#
$schema: http://devicetree.org/meta-schemas/core.yaml#

title: Clockwork ClockworkPi CPI3 2.7" LCD panel

description: |
  2.7" 320x240 LCD panel assembly used in the Clockwork Tech ClockworkPi
  CPI3 handheld game console.  The panel is connected to the SoC's parallel
  RGB output via an on-board bridge.  Initialization of the LCD controller
  is handled separately by the kd027-lcd driver.

maintainers:
  - Clockwork Tech LLC <linux@clockworkpi.com>

allOf:
  - $ref: panel-common.yaml#

properties:
  compatible:
    const: clockwork,cpi3-lcd

  power-supply:
    description: Regulator supplying the panel VCC rail.

  port: true

required:
  - compatible
  - power-supply
  - port

unevaluatedProperties: false

examples:
  - |
    panel {
        compatible = "clockwork,cpi3-lcd";
        power-supply = <&reg_dc1sw>;

        port {
            rgb_input: endpoint {
                remote-endpoint = <&tcon0_out_rgb>;
            };
        };
    };
```

## Documentation/devicetree/bindings/display/panel/kd027-lcd.yaml
```yaml
# SPDX-License-Identifier: (GPL-2.0-only OR BSD-2-Clause)
%YAML 1.2
---
$id: http://devicetree.org/schemas/display/panel/kd027-lcd.yaml#
$schema: http://devicetree.org/meta-schemas/core.yaml#

title: KD027 GPIO bit-banged SPI LCD controller

description: |
  The KD027 is an LCD controller driven via a bit-banged 4-wire SPI
  interface.  Initialization, suspend and resume sequences are supplied
  as byte arrays in the device tree.

maintainers:
  - Clockwork Tech LLC <linux@clockworkpi.com>

properties:
  compatible:
    const: kd027-lcd

  lcd-rst-gpios:
    description: GPIO connected to the LCD reset line.
    maxItems: 1

  lcd-cs-gpios:
    description: GPIO connected to the SPI chip-select line.
    maxItems: 1

  lcd-sck-gpios:
    description: GPIO connected to the SPI clock line.
    maxItems: 1

  lcd-sda-gpios:
    description: GPIO connected to the SPI data line.
    maxItems: 1

  init-seq:
    description: |
      Initialization command/data byte sequence.  Each pair of bytes is
      sent as a (command, data) tuple over the bit-banged SPI interface.
      Must contain an even number of bytes.
    $ref: /schemas/types.yaml#/definitions/uint8-array
    minItems: 2
    maxItems: 100

  suspend-seq:
    description: |
      Command/data byte sequence to send on system suspend.
      Must contain an even number of bytes.  Optional; if absent the
      LCD is not touched during suspend.
    $ref: /schemas/types.yaml#/definitions/uint8-array
    minItems: 2
    maxItems: 20

  resume-seq:
    description: |
      Command/data byte sequence to send on system resume.
      Must contain an even number of bytes.  Optional; if absent the
      LCD is not touched during resume.
    $ref: /schemas/types.yaml#/definitions/uint8-array
    minItems: 2
    maxItems: 20

required:
  - compatible
  - lcd-rst-gpios
  - lcd-cs-gpios
  - lcd-sck-gpios
  - lcd-sda-gpios
  - init-seq

additionalProperties: false

examples:
  - |
    #include <dt-bindings/gpio/gpio.h>
    lcd {
        compatible = "kd027-lcd";
        lcd-rst-gpios = <&pio 1 2 GPIO_ACTIVE_HIGH>;
        lcd-cs-gpios  = <&pio 2 3 GPIO_ACTIVE_HIGH>;
        lcd-sck-gpios = <&pio 2 2 GPIO_ACTIVE_HIGH>;
        lcd-sda-gpios = <&pio 2 0 GPIO_ACTIVE_HIGH>;
        init-seq    = /bits/ 8 <0x2b 0x01 0x00 0x07 0x0c 0x27 0x16 0x04>;
        suspend-seq = /bits/ 8 <0x2b 0x00>;
        resume-seq  = /bits/ 8 <0x2b 0x01>;
    };
```

## Documentation/devicetree/bindings/leds/backlight/ocp8178-backlight.yaml
```yaml
# SPDX-License-Identifier: (GPL-2.0-only OR BSD-2-Clause)
%YAML 1.2
---
$id: http://devicetree.org/schemas/leds/backlight/ocp8178-backlight.yaml#
$schema: http://devicetree.org/meta-schemas/core.yaml#

title: OCP8178 GPIO-controlled LED backlight

description: |
  The OCP8178 is a boost-converter LED backlight IC whose brightness is
  controlled by counting pulses on a single GPIO line (the "expresswire"
  protocol). The driver bit-bangs this protocol from the GPIO.

maintainers:
  - Clockwork Tech LLC <linux@clockworkpi.com>

allOf:
  - $ref: common.yaml#

properties:
  compatible:
    const: ocp8178-backlight

  backlight-control-gpios:
    description: GPIO connected to the OCP8178 backlight control pin.
    maxItems: 1

  default-brightness: true
  max-brightness: true

required:
  - compatible
  - backlight-control-gpios

additionalProperties: false

examples:
  - |
    #include <dt-bindings/gpio/gpio.h>
    backlight {
        compatible = "ocp8178-backlight";
        backlight-control-gpios = <&pio 7 1 GPIO_ACTIVE_HIGH>;
        default-brightness = <5>;
    };
```
